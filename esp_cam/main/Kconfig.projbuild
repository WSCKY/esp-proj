## esp_cam/main/Kconfig.projbuild
```kconfig
menu "Project configuration"

choice CAMERA_BOARD
    prompt "Camera board"
    default ESP32_CAMERA_BOARD
    help
        Select a Camera board to use with the ESP-IDF
config ESP32_CAMERA_BOARD
    bool "ESP32-Camera"
config M5_CAMERA_A_BOARD
    bool "M5-Camera A"
config M5_CAMERA_B_BOARD
    bool "M5-Camera B"
config M5_CAMERA_X_BOARD
    bool "M5-Camera X"
config M5_CAMERA_F_BOARD
    bool "M5-Camera F"
endchoice

config CAMERA_WIFI_AP
    bool
    prompt "choose WiFi mode in AP"
    default "y"
    help
        WiFi mode selection

choice IMG_TX_PROTOCOL
    prompt "image transfer protocol"
    default HTTP_SERVER
    help
        choose the image transfer protocol
config TX_HTTP_SERVER
    bool "Http server"
config TX_TCP_SOCKET
    bool "Socket TCP"
config TX_UDP_SOCKET
    bool "Socket UDP"
endchoice

config EXAMPLE_PORT
        int "Port"
        range 0 65535
        default 3333
        help
            Local port the example server will listen on.

endmenu
```

## lcd_driver/main/Kconfig.projbuild
```kconfig
menu "Example Configuration"

config LCD_OVERCLOCK
	bool
	prompt "Run LCD at higher clock speed than allowed"
	default "n"
	help
		The ILI9341 and ST7789 specify that the maximum clock speed for the SPI interface is 10MHz. However,
		in practice the driver chips work fine with a higher clock rate, and using that gives a better framerate.
		Select this to try using the out-of-spec clock rate.

config LED_GPIO
    int "LED GPIO Number"
        range 0 34
	default 21
	help 
	    GPIO number (IOxx) to control LED on and off.

	    Some GPIOs are used for other purposes (flash connections, etc.) and cannot be used to drive LED.

	    GPIOs 35-39 are input-only so cannot be used as outputs.

endmenu
```
